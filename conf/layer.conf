## conf/layer.conf
```bitbake
# We have a conf and classes directory, append to BBPATH
BBPATH .= ":${LAYERDIR}"

# We have a recipes directory, add to BBFILES
BBFILES += "${LAYERDIR}/recipes-*/*/*.bb ${LAYERDIR}/recipes-*/*/*.bbappend"

BBFILE_COLLECTIONS += "chainer-layer"
BBFILE_PATTERN_chainer-layer := "^${LAYERDIR}/"
BBFILE_PRIORITY_chainer-layer = "7"

LAYERVERSION_chainer-layer = "1"
LAYERDEPENDS_meta-chainer = "core openembedded-layer meta-python"
```
